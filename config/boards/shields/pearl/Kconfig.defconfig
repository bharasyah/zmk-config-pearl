## config/boards/shields/pearl/Kconfig.defconfig
```kconfig
# Copyright (c) 2021 The ZMK Contributors
# SPDX-License-Identifier: MIT

if SHIELD_PEARL

config ZMK_KEYBOARD_NAME
    default "pearl"

endif
```
